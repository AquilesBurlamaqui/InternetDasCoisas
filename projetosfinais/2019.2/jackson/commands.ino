static const unsigned char PROGMEM happyFace[] =
{   
  0x00, 0x00, 0x00, 0x00, 0x00, 0x00, 0x00, 0x00, 0x00, 0x00, 0x00, 0x00, 0x00, 0x00, 0x00, 0x00, 
  0x00, 0x00, 0x00, 0x00, 0x00, 0x00, 0x00, 0x00, 0x00, 0x00, 0x00, 0x00, 0x00, 0x00, 0x00, 0x00, 
  0x00, 0x00, 0x00, 0x00, 0x00, 0x00, 0x00, 0x00, 0x00, 0x00, 0x00, 0x00, 0x00, 0x00, 0x00, 0x00, 
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  0x00, 0x00, 0x00, 0x00, 0x00, 0x00, 0x00, 0x00, 0x00, 0x00, 0x00, 0x00, 0x00, 0x00, 0x00, 0x00,   };

  void comando(String text) {
  Serial.print("RECEBIDO:");
  Serial.println(text);
  if(text.indexOf("motor") > 0) {
    if(text.indexOf("frente") > 0) {
      motor.write(0);
      delay(2000);
      motor.write(90);
    } else if(text.indexOf("trás") > 0) {
      motor.write(180);
      delay(2000);
      motor.write(90);
    }
    
  } else if(text.indexOf("luz") > 0) {
    
    if(text.indexOf("ligar") > 0) {
      digitalWrite(led, 1);
    } else if(text.indexOf("apagar") > 0) {
      digitalWrite(led, 0);
    }
    
  } else if(text.indexOf("sorriso") > 0) {
    
    display.clearDisplay();
    display.drawBitmap(0, 0, happyFace, 128, 64, 1);
    display.display();
    delay(2000);
    display.clearDisplay();
    display.setCursor(0, 0);
    display.println("Connected to:");
    display.println(ssid);
    display.println("");
    display.print("IP: ");
    display.println(WiFi.localIP());
    display.display();
    
  } else {
    Serial.println("Nenhum Comando!!");  
  }
}
